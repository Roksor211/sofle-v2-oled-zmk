## boards/shields/sofle_rgb_ext/Kconfig
```kconfig
# Kconfig for sofle_rgb_ext shield
config ZMK_KEYBOARD_SOFTWARE
    bool "Enable sofle_rgb_ext"
    default y
```

## config/west.yml
```yaml
manifest:
  defaults:
    remote: zmkfirmware
  remotes:
    - name: zmkfirmware
      url-base: https://github.com/zmkfirmware
  projects:
    - name: zmk
      path: zmk
      revision: main
      west-commands: zmk/west.yml
    - name: sofle_rgb_ext
      path: modules/sofle_rgb_ext
      revision: main
      west-commands: none
  self:
    path: config
```
